## wave-platform/poky/meta-qti-bsp/conf/distro/mdm-perf.conf
```bitbake
###############################################################################################
#@TYPE: Distribution
#@NAME: MDM-PERF
#@DESCRIPTION: QTI Linux Distribution for MDM targets with performance orientation (glibc based)
################################################################################################

require conf/distro/include/msm.inc

# DISTRO CONFIGURATION
DISTRO_NAME = "mdm-perf"
DISTRO_VERSION = "${BUILDNAME}"
VIRTUAL-RUNTIME_dev_manager ?= "busybox-mdev"

# Add mdm-perf to distro overrides
DISTROOVERRIDES = "mdm:mdm-perf"

# Basic distribution features
DISTRO_FEATURES += "sysvinit eabi ipv6 ipv4 largefile thumb-interwork xattr ${MICRO_GOLD} ${DISTRO_FEATURES_LIBC}"

# MDMs are NAND based targets
DISTRO_FEATURES += "nand-boot"

# Enable performance features
DISTRO_FEATURES += "qti-perf"

# TEMP FIX: retain existing directory structure for base product image.
DEPLOY_NAME ?= "${@base_contains('PRODUCT', 'base', '${MACHINE}', '${MACHINE}-${PRODUCT}', d)}-perf"
DEPLOY_DIR_IMAGE = "${DEPLOY_DIR}/images/${DEPLOY_NAME}"
```

## wave-platform/poky/meta-qti-bsp/conf/distro/mdm.conf
```bitbake
#############################################################################
#@TYPE: Distribution
#@NAME: MDM
#@DESCRIPTION: QTI Linux Distribution for MDM targets (glibc based)
#############################################################################

require conf/distro/include/msm.inc

# DISTRO CONFIGURATION
DISTRO_NAME = "mdm"
DISTRO_VERSION = "${BUILDNAME}"
VIRTUAL-RUNTIME_dev_manager ?= "busybox-mdev"

# Add distro overrides
DISTROOVERRIDES = "mdm"

# Basic distribution features
DISTRO_FEATURES += "sysvinit eabi ipv6 ipv4 largefile thumb-interwork xattr ${MICRO_GOLD} ${DISTRO_FEATURES_LIBC}"

# MDMs are nand based targets
DISTRO_FEATURES += "nand-boot"

# TEMP FIX: retain existing directory structure for base product image.
DEPLOY_NAME ?= "${@base_contains('PRODUCT', 'base', '${MACHINE}', '${MACHINE}-${PRODUCT}', d)}"
DEPLOY_DIR_IMAGE = "${DEPLOY_DIR}/images/${DEPLOY_NAME}"
```

## wave-platform/poky/meta-qti-bsp/conf/distro/msm-perf.conf
```bitbake
###############################################################################################
#@TYPE: Distribution
#@NAME: MSM-PERF
#@DESCRIPTION: QTI Linux Distribution for MSM targets with performance orientation (glibc based)
################################################################################################

require conf/distro/include/msm.inc

# DISTRO CONFIGURATION
DISTRO_NAME = "msm-perf"
DISTRO_VERSION = "${BUILDNAME}"
VIRTUAL-RUNTIME_dev_manager ?= "busybox-mdev"

# Add msm-perf to distro overrides
DISTROOVERRIDES = "msm:msm-perf"

# Basic distribution features
DISTRO_FEATURES += "sysvinit eabi ipv6 ipv4 largefile thumb-interwork xattr ${MICRO_GOLD} ${DISTRO_FEATURES_LIBC}"

# MSMs are emmc based targets
DISTRO_FEATURES += "emmc-boot"

# Enable performance features
DISTRO_FEATURES += "qti-perf"

# TEMP FIX: retain existing directory structure for base product image.
DEPLOY_NAME ?= "${@base_contains('PRODUCT', 'base', '${MACHINE}', '${MACHINE}-${PRODUCT}', d)}-perf"
DEPLOY_DIR_IMAGE = "${DEPLOY_DIR}/images/${DEPLOY_NAME}"
```

## wave-platform/poky/meta-qti-bsp/conf/machine/apq8017.conf
```bitbake
#@TYPE: Machine
#@NAME: APQ8017
#@DESCRIPTION: Machine configuration for QTI MTP with APQ8017

require conf/machine/include/apq8017.inc

PREFERRED_PROVIDER_virtual/kernel ?= "linux-quic"

KERNEL_IMAGETYPE = "Image.gz-dtb"
KERNEL_DTS_NAME = "msm8917"
KERNEL_BASE = "0x81C00000"
KERNEL_TAGS_OFFSET = "0x81900000"
KERNEL_DEFCONFIG = "msm8937_defconfig"
KERNEL_PERF_DEFCONFIG = "msm8937-perf_defconfig"
KERNEL_CMD_PARAMS = "noinitrd rw console=ttyHSL0,115200,n8 androidboot.hardware=qcom ehci-hcd.park=3 msm_rtb.filter=0x37 lpm_levels.sleep_disabled=1 root=/dev/mmcblk0p24 rootfstype=ext4 rootwait androidboot.bootdevice=7824900.sdhci"
```

## wave-platform/poky/meta-qti-bsp/conf/machine/apq8053-iot-mtp.conf
```bitbake
#@TYPE: Machine
#@NAME: APQ8053-IOT-MTP
#@DESCRIPTION: Machine configuration for QTI IOT MTP with APQ8053

require conf/machine/include/apq8053.inc

PREFERRED_PROVIDER_virtual/kernel ?= "linux-quic"

KERNEL_IMAGETYPE = "Image.gz-dtb"
KERNEL_DTS_NAME = "msm8953"
KERNEL_BASE = "0x80000000"
KERNEL_TAGS_OFFSET = "0x81900000"
KERNEL_DEFCONFIG = "msmcortex_defconfig"
KERNEL_CMD_PARAMS = "noinitrd rw console=ttyHSL0,115200,n8 androidboot.hardware=qcom ehci-hcd.park=3 msm_rtb.filter=0x37 lpm_levels.sleep_disabled=1 root=/dev/mmcblk0p24 rootfstype=ext4 rootwait androidboot.bootdevice=7824900.sdhci"

# Perf kernel configs
KERNEL_PERF_IMAGETYPE = "Image-dtb"
KERNEL_PERF_DEFCONFIG = "apq8053_IoE-perf_defconfig"
KERNEL_PERF_CMD_PARAMS = "noinitrd rw androidboot.hardware=qcom ehci-hcd.park=3 msm_rtb.filter=0x37 lpm_levels.sleep_disabled=1 root=/dev/mmcblk0p24 rootfstype=ext4 rootwait androidboot.bootdevice=7824900.sdhci"

DISTRO_FEATURES_append += "selinux"
# Freeze refpolicy at the latest version supported by meta-selinux
PREFERRED_VERSION_refpolicy-standard="2.20141203"
DEFAULT_ENFORCING = "permissive"
```

## wave-platform/poky/meta-qti-bsp/conf/machine/apq8053.conf
```bitbake
#@TYPE: Machine
#@NAME: APQ8053
#@DESCRIPTION: Machine configuration for QTI MTP with APQ8053

require conf/machine/include/apq8053.inc

PREFERRED_PROVIDER_virtual/kernel ?= "linux-quic"

KERNEL_IMAGETYPE = "Image.gz-dtb"
KERNEL_DTS_NAME = "msm8953"
KERNEL_BASE = "0x80000000"
KERNEL_TAGS_OFFSET = "0x81900000"
KERNEL_DEFCONFIG = "msmcortex_defconfig"
KERNEL_CMD_PARAMS = "noinitrd ro console=ttyHSL0,115200,n8 androidboot.hardware=qcom ehci-hcd.park=3 msm_rtb.filter=0x37 lpm_levels.sleep_disabled=1 rootwait androidboot.bootdevice=7824900.sdhci"

# Perf kernel configs
KERNEL_PERF_IMAGETYPE = "Image.gz-dtb"
KERNEL_PERF_DEFCONFIG = "msmcortex-perf_defconfig"
KERNEL_PERF_CMD_PARAMS = "noinitrd ro androidboot.hardware=qcom ehci-hcd.park=3 msm_rtb.filter=0x37 lpm_levels.sleep_disabled=1 rootwait androidboot.bootdevice=7824900.sdhci"

DISTRO_FEATURES_append=" selinux"
# Freeze refpolicy at the latest version supported by meta-selinux
PREFERRED_VERSION_refpolicy-standard="2.20141203"
DEFAULT_ENFORCING = "permissive"
DISTRO_FEATURES_append += " ro-rootfs"
```

## wave-platform/poky/meta-qti-bsp/conf/machine/include/mdm9607.inc
```bitbake
BASEMACHINE ?= "mdm9607"
require conf/machine/include/basemachine.inc

SOC_FAMILY ?= "mdm9x07"
include conf/machine/include/soc-family.inc

# Uncomment the following line to enable the hard floating point abi. Note that
# this breaks some binary libraries and 3D (neither of which ship with
# meta-yocto). For maximum compatibility, leave this disabled.
#DEFAULTTUNE ?= "cortexa8hf-neon"

require conf/machine/include/tune-cortexa8.inc

BBMASK = ".*/*/recipes-kernel/linux-msm-4.4"

MACHINE_DISPLAY_WIDTH_PIXELS ?= "480"
MACHINE_DISPLAY_HEIGHT_PIXELS ?= "640"

SERIAL_CONSOLE ?= "115200 ttyHSL0"

DISTRO ?= "mdm"

MACHINE_FEATURES += "kernel26 keyboard"

PAGE_SIZE ?= '4096'

# Max supported inodes
EXTRA_IMAGECMD ?= "-N 2048"

#UBINIZE Args
UBINIZE_ARGS ?= "-m 4096 -p 256KiB -s 4096"
#MKUBIFS Arg
MKUBIFS_ARGS ?= "-m 4096 -e 253952 -c 2146 -F"
#Volume sizes
SYSTEM_VOLUME_SIZE ?= "63MiB"
CACHE_VOLUME_SIZE ?= "55MiB"
```

## wave-platform/poky/meta-qti-bsp/conf/machine/sdxhedgehog.conf
```bitbake
#@TYPE: Machine
#@NAME: SDXHEDGEHOG
#@DESCRIPTION: Machine configuration for QTI SDXHEDGEHOG

require conf/machine/include/sdxhedgehog.inc

PREFERRED_PROVIDER_virtual/kernel ?= "linux-quic"

KERNEL_IMAGETYPE = "zImage"
KERNEL_DTS_NAME = "sdxhedgehog"
KERNEL_BASE = "0x80000000"
KERNEL_TAGS_OFFSET = "0x82000000"
KERNEL_DEFCONFIG = "sdx_defconfig"
KERNEL_PERF_DEFCONFIG = "sdx-perf_defconfig"
KERNEL_CMD_PARAMS = "noinitrd rw console=ttyHSL0,115200,n8 androidboot.hardware=qcom ehci-hcd.park=3 msm_rtb.filter=0x37 lpm_levels.sleep_disabled=1 earlycon=msm_hsl_uart,0x78b1000"

# Pull in security flags
require ${COREBASE}/meta-qti-bsp/conf/distro/include/security_flags.inc
```
